## examples/esp32-runtime/sdkconfig.defaults
```kconfig
CONFIG_IDF_TARGET="esp32"
CONFIG_ESPTOOLPY_FLASHSIZE_4MB=y
CONFIG_ESP_CONSOLE_UART_DEFAULT=y
CONFIG_WAMR_ENABLE_INTERP=y
CONFIG_WAMR_INTERP_CLASSIC=y
CONFIG_WAMR_INTERP_LOADER_NORMAL=y
CONFIG_WAMR_ENABLE_AOT=n
CONFIG_WAMR_ENABLE_LIBC_BUILTIN=n
CONFIG_WAMR_ENABLE_LIBC_WASI=n
CONFIG_WAMR_ENABLE_LIB_PTHREAD=n
CONFIG_WAMR_ENABLE_MULTI_MODULE=n
CONFIG_WAMR_ENABLE_SHARED_MEMORY=n
CONFIG_WAMR_ENABLE_REF_TYPES=n
```
